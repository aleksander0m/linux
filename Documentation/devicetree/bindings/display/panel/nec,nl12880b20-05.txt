## Documentation/devicetree/bindings/display/panel/nec,nl12880b20-05.txt
```
NEC LCD Technologies, Ltd. 12.1" WXGA (1280x800) LVDS TFT LCD panel

Required properties:
- compatible: should be "nec,nl12880bc20-05"

This binding is compatible with the simple-panel binding, which is specified
in simple-panel.txt in this directory.
```

## Documentation/devicetree/bindings/display/panel/nlt,nl192108ac18-02d.txt
```
NLT Technologies, Ltd. 15.6" FHD (1920x1080) LVDS TFT LCD panel

Required properties:
- compatible: should be "nlt,nl192108ac18-02d"

This binding is compatible with the simple-panel binding, which is specified
in simple-panel.txt in this directory.
```
